/*
 * Copyright (c) 2023-2024 HPMicro
 * SPDX-License-Identifier: BSD-3-Clause
 *
 *
 */

#include "board.h"
#include "hpm_uart_drv.h"
#include "hpm_gptmr_drv.h"
#include "hpm_i2c_drv.h"
#include "hpm_gpio_drv.h"
#include "pinmux.h"
#include "hpm_pmp_drv.h"
#include "hpm_clock_drv.h"
#include "hpm_sysctl_drv.h"
#include "hpm_pllctlv2_drv.h"
#include "hpm_pcfg_drv.h"
#include "hpm_enet_drv.h"
#include "hpm_usb_drv.h"
#include "hpm_femc_drv.h"
#include "hpm_pwmv2_drv.h"
#include "hpm_esc_drv.h"

static board_timer_cb timer_cb;

/**
 * @brief FLASH configuration option definitions:
 * option[0]:
 *    [31:16] 0xfcf9 - FLASH configuration option tag
 *    [15:4]  0 - Reserved
 *    [3:0]   option words (exclude option[0])
 * option[1]:
 *    [31:28] Flash probe type
 *      0 - SFDP SDR / 1 - SFDP DDR
 *      2 - 1-4-4 Read (0xEB, 24-bit address) / 3 - 1-2-2 Read(0xBB, 24-bit address)
 *      4 - HyperFLASH 1.8V / 5 - HyperFLASH 3V
 *      6 - OctaBus DDR (SPI -> OPI DDR)
 *      8 - Xccela DDR (SPI -> OPI DDR)
 *      10 - EcoXiP DDR (SPI -> OPI DDR)
 *    [27:24] Command Pads after Power-on Reset
 *      0 - SPI / 1 - DPI / 2 - QPI / 3 - OPI
 *    [23:20] Command Pads after Configuring FLASH
 *      0 - SPI / 1 - DPI / 2 - QPI / 3 - OPI
 *    [19:16] Quad Enable Sequence (for the device support SFDP 1.0 only)
 *      0 - Not needed
 *      1 - QE bit is at bit 6 in Status Register 1
 *      2 - QE bit is at bit1 in Status Register 2
 *      3 - QE bit is at bit7 in Status Register 2
 *      4 - QE bit is at bit1 in Status Register 2 and should be programmed by 0x31
 *    [15:8] Dummy cycles
 *      0 - Auto-probed / detected / default value
 *      Others - User specified value, for DDR read, the dummy cycles should be 2 * cycles on FLASH datasheet
 *    [7:4] Misc.
 *      0 - Not used
 *      1 - SPI mode
 *      2 - Internal loopback
 *      3 - External DQS
 *    [3:0] Frequency option
 *      1 - 30MHz / 2 - 50MHz / 3 - 66MHz / 4 - 80MHz / 5 - 100MHz / 6 - 120MHz / 7 - 133MHz / 8 - 166MHz
 *
 * option[2] (Effective only if the bit[3:0] in option[0] > 1)
 *    [31:20]  Reserved
 *    [19:16] IO voltage
 *      0 - 3V / 1 - 1.8V
 *    [15:12] Pin group
 *      0 - 1st group / 1 - 2nd group
 *    [11:8] Connection selection
 *      0 - CA_CS0 / 1 - CB_CS0 / 2 - CA_CS0 + CB_CS0 (Two FLASH connected to CA and CB respectively)
 *    [7:0] Drive Strength
 *      0 - Default value
 * option[3] (Effective only if the bit[3:0] in option[0] > 2, required only for the QSPI NOR FLASH that not supports
 *              JESD216)
 *    [31:16] reserved
 *    [15:12] Sector Erase Command Option, not required here
 *    [11:8]  Sector Size Option, not required here
 *    [7:0] Flash Size Option
 *      0 - 4MB / 1 - 8MB / 2 - 16MB
 */
#if defined(FLASH_XIP) && FLASH_XIP
__attribute__((section(".nor_cfg_option"))) const uint32_t option[4] = { 0xfcf90001, 0x00000007, 0x0, 0x0 };
#endif

#if defined(FLASH_UF2) && FLASH_UF2
ATTR_PLACE_AT(".uf2_signature") const uint32_t uf2_signature = BOARD_UF2_SIGNATURE;
#endif

void board_init_console(void)
{
#if !defined(CONFIG_NDEBUG_CONSOLE) || !CONFIG_NDEBUG_CONSOLE
#if BOARD_CONSOLE_TYPE == CONSOLE_TYPE_UART
    console_config_t cfg;

    /* uart needs to configure pin function before enabling clock, otherwise the level change of
     * uart rx pin when configuring pin function will cause a wrong data to be received.
     * And a uart rx dma request will be generated by default uart fifo dma trigger level.
     */
    init_uart_pins((UART_Type *) BOARD_CONSOLE_UART_BASE);

    /* Configure the UART clock to 24MHz */
    clock_set_source_divider(BOARD_CONSOLE_UART_CLK_NAME, clk_src_osc24m, 1U);
    clock_add_to_group(BOARD_CONSOLE_UART_CLK_NAME, 0);

    cfg.type = BOARD_CONSOLE_TYPE;
    cfg.base = (uint32_t) BOARD_CONSOLE_UART_BASE;
    cfg.src_freq_in_hz = clock_get_frequency(BOARD_CONSOLE_UART_CLK_NAME);
    cfg.baudrate = BOARD_CONSOLE_UART_BAUDRATE;

    if (status_success != console_init(&cfg)) {
        /* failed to  initialize debug console */
        while (1) {
        }
    }
#else
    while (1)
        ;
#endif
#endif
}

void board_print_clock_freq(void)
{
    printf("==============================\n");
    printf(" %s clock summary\n", BOARD_NAME);
    printf("==============================\n");
    printf("cpu0:\t\t %dHz\n", clock_get_frequency(clock_cpu0));
    printf("cpu1:\t\t %dHz\n", clock_get_frequency(clock_cpu1));
    printf("ahb:\t\t %luHz\n", clock_get_frequency(clock_ahb0));
    printf("axif:\t\t %dHz\n", clock_get_frequency(clock_axif));
    printf("axis:\t\t %dHz\n", clock_get_frequency(clock_axis));
    printf("axic:\t\t %dHz\n", clock_get_frequency(clock_axic));
    printf("axin:\t\t %dHz\n", clock_get_frequency(clock_axin));
    printf("xpi0:\t\t %dHz\n", clock_get_frequency(clock_xpi0));
    printf("femc:\t\t %luHz\n", clock_get_frequency(clock_femc));
    printf("mchtmr0:\t %dHz\n", clock_get_frequency(clock_mchtmr0));
    printf("mchtmr1:\t %dHz\n", clock_get_frequency(clock_mchtmr1));
    printf("==============================\n");
}

void board_init_uart(UART_Type *ptr)
{
    /* configure uart's pin before opening uart's clock */
    init_uart_pins(ptr);
    board_init_uart_clock(ptr);
}

void board_print_banner(void)
{
    const uint8_t banner[] = { "\n\
----------------------------------------------------------------------\n\
$$\\   $$\\ $$$$$$$\\  $$\\      $$\\ $$\\\n\
$$ |  $$ |$$  __$$\\ $$$\\    $$$ |\\__|\n\
$$ |  $$ |$$ |  $$ |$$$$\\  $$$$ |$$\\  $$$$$$$\\  $$$$$$\\   $$$$$$\\\n\
$$$$$$$$ |$$$$$$$  |$$\\$$\\$$ $$ |$$ |$$  _____|$$  __$$\\ $$  __$$\\\n\
$$  __$$ |$$  ____/ $$ \\$$$  $$ |$$ |$$ /      $$ |  \\__|$$ /  $$ |\n\
$$ |  $$ |$$ |      $$ |\\$  /$$ |$$ |$$ |      $$ |      $$ |  $$ |\n\
$$ |  $$ |$$ |      $$ | \\_/ $$ |$$ |\\$$$$$$$\\ $$ |      \\$$$$$$  |\n\
\\__|  \\__|\\__|      \\__|     \\__|\\__| \\_______|\\__|       \\______/\n\
----------------------------------------------------------------------\n" };
#ifdef SDK_VERSION_STRING
    printf("hpm_sdk: %s\n", SDK_VERSION_STRING);
#endif
    printf("%s", banner);
}

void board_ungate_mchtmr_at_lp_mode(void)
{
    /* Keep cpu clock on wfi, so that mchtmr irq can still work after wfi */
    sysctl_set_cpu_lp_mode(HPM_SYSCTL, BOARD_RUNNING_CORE, cpu_lp_mode_ungate_cpu_clock);
}

void board_init(void)
{
    board_init_clock();
    board_init_console();
    board_init_pmp();
#if BOARD_SHOW_CLOCK
    board_print_clock_freq();
#endif
#if BOARD_SHOW_BANNER
    board_print_banner();
#endif
}

void board_delay_us(uint32_t us)
{
    clock_cpu_delay_us(us);
}

void board_delay_ms(uint32_t ms)
{
    clock_cpu_delay_ms(ms);
}

void board_timer_isr(void)
{
    if (gptmr_check_status(BOARD_CALLBACK_TIMER, GPTMR_CH_RLD_STAT_MASK(BOARD_CALLBACK_TIMER_CH))) {
        gptmr_clear_status(BOARD_CALLBACK_TIMER, GPTMR_CH_RLD_STAT_MASK(BOARD_CALLBACK_TIMER_CH));
        timer_cb();
    }
}

SDK_DECLARE_EXT_ISR_M(BOARD_CALLBACK_TIMER_IRQ, board_timer_isr);

void board_timer_create(uint32_t ms, board_timer_cb cb)
{
    uint32_t gptmr_freq;
    gptmr_channel_config_t config;

    timer_cb = cb;
    gptmr_channel_get_default_config(BOARD_CALLBACK_TIMER, &config);

    clock_add_to_group(BOARD_CALLBACK_TIMER_CLK_NAME, 0);
    gptmr_freq = clock_get_frequency(BOARD_CALLBACK_TIMER_CLK_NAME);

    config.reload = gptmr_freq / 1000 * ms;
    gptmr_channel_config(BOARD_CALLBACK_TIMER, BOARD_CALLBACK_TIMER_CH, &config, false);
    gptmr_enable_irq(BOARD_CALLBACK_TIMER, GPTMR_CH_RLD_IRQ_MASK(BOARD_CALLBACK_TIMER_CH));
    intc_m_enable_irq_with_priority(BOARD_CALLBACK_TIMER_IRQ, 1);

    gptmr_start_counter(BOARD_CALLBACK_TIMER, BOARD_CALLBACK_TIMER_CH);
}

void board_control_led(uint8_t index, uint8_t flag)
{
    switch (index)
    {
        case BOARD_LED0_CTRL_INDEX: 
            if(flag == 0) {
                gpio_write_pin(BOARD_LED0_GPIO_CTRL, BOARD_LED0_GPIO_INDEX, BOARD_LED0_GPIO_PIN, false);
            } else if(flag == 1) {
                gpio_write_pin(BOARD_LED0_GPIO_CTRL, BOARD_LED0_GPIO_INDEX, BOARD_LED0_GPIO_PIN, true);
            } else {
                gpio_toggle_pin(BOARD_LED0_GPIO_CTRL, BOARD_LED0_GPIO_INDEX, BOARD_LED0_GPIO_PIN);
            }
            break;
        case BOARD_LED1_CTRL_INDEX:
            if(flag == 0) {
                gpio_write_pin(BOARD_LED1_GPIO_CTRL, BOARD_LED1_GPIO_INDEX, BOARD_LED1_GPIO_PIN, false);
            } else if(flag == 1) {
                gpio_write_pin(BOARD_LED1_GPIO_CTRL, BOARD_LED1_GPIO_INDEX, BOARD_LED1_GPIO_PIN, true);
            } else {
                gpio_toggle_pin(BOARD_LED1_GPIO_CTRL, BOARD_LED1_GPIO_INDEX, BOARD_LED1_GPIO_PIN);
            }
            break;
        default:
            break;
    }
}

void board_init_led(void)
{
    init_led_pins_as_gpio();
    /* led0 */
    gpio_set_pin_output_with_initial(BOARD_LED0_GPIO_CTRL, BOARD_LED0_GPIO_INDEX, BOARD_LED0_GPIO_PIN, false);
    /* led1 */
    gpio_set_pin_output_with_initial(BOARD_LED1_GPIO_CTRL, BOARD_LED1_GPIO_INDEX, BOARD_LED1_GPIO_PIN, false);
}

void board_init_key(void)
{
    init_key_pins();
    gpio_set_pin_input(BOARD_KEYA_GPIO_CTRL, BOARD_KEYA_GPIO_INDEX, BOARD_KEYA_GPIO_PIN);
    gpio_set_pin_input(BOARD_KEYB_GPIO_CTRL, BOARD_KEYB_GPIO_INDEX, BOARD_KEYB_GPIO_PIN);
    gpio_set_pin_input(BOARD_KEYC_GPIO_CTRL, BOARD_KEYC_GPIO_INDEX, BOARD_KEYC_GPIO_PIN);
    gpio_set_pin_input(BOARD_KEYD_GPIO_CTRL, BOARD_KEYD_GPIO_INDEX, BOARD_KEYD_GPIO_PIN);
}

void board_lcd_bl(bool enabled)
{
    if(enabled) {
        gpio_write_pin(BOARD_LCD_BL_CTRL, BOARD_LCD_BL_INDEX, BOARD_LCD_BL_PIN, false);
    } else {
        gpio_write_pin(BOARD_LCD_BL_CTRL, BOARD_LCD_BL_INDEX, BOARD_LCD_BL_PIN, true);
    }
}

void board_lcd_d_c(bool enabled)
{
    if(enabled) {
        gpio_write_pin(BOARD_LCD_D_C_CTRL, BOARD_LCD_D_C_INDEX, BOARD_LCD_D_C_PIN, true);
    } else {
        gpio_write_pin(BOARD_LCD_D_C_CTRL, BOARD_LCD_D_C_INDEX, BOARD_LCD_D_C_PIN, false);
    }
}

void board_lcd_reset(uint16_t ms)
{
    gpio_write_pin(BOARD_LCD_RESET_CTRL, BOARD_LCD_RESET_INDEX, BOARD_LCD_RESET_PIN, false);
    board_delay_ms(ms);
    gpio_write_pin(BOARD_LCD_RESET_CTRL, BOARD_LCD_RESET_INDEX, BOARD_LCD_RESET_PIN, true);
}

void board_init_lcd(void)
{
    init_lcd_pins();
    /* lcd bl */
    gpio_set_pin_output_with_initial(BOARD_LCD_BL_CTRL, BOARD_LCD_BL_INDEX, BOARD_LCD_BL_PIN, true);
    /* lcd d/c */
    gpio_set_pin_output_with_initial(BOARD_LCD_D_C_CTRL, BOARD_LCD_D_C_INDEX, BOARD_LCD_D_C_PIN, false);
    /* lcd reset */
    gpio_set_pin_output_with_initial(BOARD_LCD_RESET_CTRL, BOARD_LCD_RESET_INDEX, BOARD_LCD_RESET_PIN, false);
}

void board_init_pmp(void)
{
    uint32_t start_addr;
    uint32_t end_addr;
    uint32_t length;
    pmp_entry_t pmp_entry[16];
    uint8_t index = 0;

    /* Init noncachable memory */
    extern uint32_t __noncacheable_start__[];
    extern uint32_t __noncacheable_end__[];
    start_addr = (uint32_t) __noncacheable_start__;
    end_addr = (uint32_t) __noncacheable_end__;
    length = end_addr - start_addr;
    if (length > 0) {
        /* Ensure the address and the length are power of 2 aligned */
        assert((length & (length - 1U)) == 0U);
        assert((start_addr & (length - 1U)) == 0U);
        pmp_entry[index].pmp_addr = PMP_NAPOT_ADDR(start_addr, length);
        pmp_entry[index].pmp_cfg.val = PMP_CFG(READ_EN, WRITE_EN, EXECUTE_EN, ADDR_MATCH_NAPOT, REG_UNLOCK);
        pmp_entry[index].pma_addr = PMA_NAPOT_ADDR(start_addr, length);
        pmp_entry[index].pma_cfg.val = PMA_CFG(ADDR_MATCH_NAPOT, MEM_TYPE_MEM_NON_CACHE_BUF, AMO_EN);
        index++;
    }

    /* Init share memory */
    extern uint32_t __share_mem_start__[];
    extern uint32_t __share_mem_end__[];
    start_addr = (uint32_t)__share_mem_start__;
    end_addr = (uint32_t)__share_mem_end__;
    length = end_addr - start_addr;
    if (length > 0) {
        /* Ensure the address and the length are power of 2 aligned */
        assert((length & (length - 1U)) == 0U);
        assert((start_addr & (length - 1U)) == 0U);
        pmp_entry[index].pmp_addr = PMP_NAPOT_ADDR(start_addr, length);
        pmp_entry[index].pmp_cfg.val = PMP_CFG(READ_EN, WRITE_EN, EXECUTE_EN, ADDR_MATCH_NAPOT, REG_UNLOCK);
        pmp_entry[index].pma_addr = PMA_NAPOT_ADDR(start_addr, length);
        pmp_entry[index].pma_cfg.val = PMA_CFG(ADDR_MATCH_NAPOT, MEM_TYPE_MEM_NON_CACHE_BUF, AMO_EN);
        index++;
    }

    pmp_config(&pmp_entry[0], index);
}

void board_init_clock(void)
{
    uint32_t cpu0_freq = clock_get_frequency(clock_cpu0);
    if (cpu0_freq == PLLCTL_SOC_PLL_REFCLK_FREQ) {
        /* Configure the External OSC ramp-up time: ~9ms */
        pllctlv2_xtal_set_rampup_time(HPM_PLLCTLV2, 32ul * 1000ul * 9u);

        /* select clock setting preset1 */
        sysctl_clock_set_preset(HPM_SYSCTL, 2);
    }
    /* Add most Clocks to group 0 */
    /* not open uart clock in this API, uart should configure pin function before opening clock */
    clock_add_to_group(clock_cpu0, 0);
    clock_add_to_group(clock_mchtmr0, 0);
    clock_add_to_group(clock_ahb0, 0);
    clock_add_to_group(clock_axif, 0);
    clock_add_to_group(clock_axis, 0);
    clock_add_to_group(clock_axic, 0);
    clock_add_to_group(clock_axin, 0);
    clock_add_to_group(clock_rom0, 0);
    clock_add_to_group(clock_xpi0, 0);
    clock_add_to_group(clock_lmm0, 0);
    clock_add_to_group(clock_lmm1, 0);
    clock_add_to_group(clock_ram0, 0);
    clock_add_to_group(clock_ram1, 0);
    clock_add_to_group(clock_hdma, 0);
    clock_add_to_group(clock_xdma, 0);
    clock_add_to_group(clock_femc, 0);

    clock_add_to_group(clock_gptmr0, 0);
    clock_add_to_group(clock_gptmr1, 0);
    clock_add_to_group(clock_gptmr2, 0);
    clock_add_to_group(clock_gptmr3, 0);
    clock_add_to_group(clock_gptmr4, 0);
    clock_add_to_group(clock_gptmr5, 0);
    clock_add_to_group(clock_gptmr6, 0);
    clock_add_to_group(clock_gptmr7, 0);
    clock_add_to_group(clock_ptpc, 0);

    clock_add_to_group(clock_puart, 0);
    clock_add_to_group(clock_watchdog0, 0);
    clock_add_to_group(clock_watchdog1, 0);
    clock_add_to_group(clock_watchdog2, 0);
    clock_add_to_group(clock_watchdog3, 0);
    clock_add_to_group(clock_pwdg, 0);

    clock_add_to_group(clock_qei0, 0);
    clock_add_to_group(clock_qei1, 0);
    clock_add_to_group(clock_qei2, 0);
    clock_add_to_group(clock_qei3, 0);
    clock_add_to_group(clock_qeo0, 0);
    clock_add_to_group(clock_qeo1, 0);
    clock_add_to_group(clock_qeo2, 0);
    clock_add_to_group(clock_qeo3, 0);
    clock_add_to_group(clock_pwm0, 0);
    clock_add_to_group(clock_pwm1, 0);
    clock_add_to_group(clock_pwm2, 0);
    clock_add_to_group(clock_pwm3, 0);
    clock_add_to_group(clock_rdc0, 0);
    clock_add_to_group(clock_rdc1, 0);
    clock_add_to_group(clock_sdm0, 0);
    clock_add_to_group(clock_sdm1, 0);
    clock_add_to_group(clock_plb0, 0);
    clock_add_to_group(clock_sei0, 0);
    clock_add_to_group(clock_mtg0, 0);
    clock_add_to_group(clock_mtg1, 0);
    clock_add_to_group(clock_vsc0, 0);
    clock_add_to_group(clock_vsc1, 0);
    clock_add_to_group(clock_clc0, 0);
    clock_add_to_group(clock_clc1, 0);
    clock_add_to_group(clock_emds, 0);

    clock_add_to_group(clock_cmp0, 0);
    clock_add_to_group(clock_cmp1, 0);
    clock_add_to_group(clock_cmp2, 0);
    clock_add_to_group(clock_cmp3, 0);

    clock_add_to_group(clock_crc0, 0);
    clock_add_to_group(clock_tsns, 0);
    clock_add_to_group(clock_mbx0, 0);
    clock_add_to_group(clock_mbx1, 0);
    clock_add_to_group(clock_gpio, 0);
    clock_add_to_group(clock_ppi0, 0);
    clock_add_to_group(clock_lobs, 0);
    clock_add_to_group(clock_rng, 0);
    clock_add_to_group(clock_sdp, 0);
    clock_add_to_group(clock_pka, 0);
    clock_add_to_group(clock_kman, 0);
    clock_add_to_group(clock_ffa0, 0);

    clock_add_to_group(clock_usb0, 0);
    clock_add_to_group(clock_esc0, 0);
    clock_add_to_group(clock_eth0, 0);
    clock_add_to_group(clock_ptp0, 0);
    clock_add_to_group(clock_ntmr0, 0);
    clock_add_to_group(clock_ref0, 0);
    clock_add_to_group(clock_ref1, 0);
    clock_add_to_group(clock_tsn1, 0);
    clock_add_to_group(clock_tsn2, 0);
    clock_add_to_group(clock_tsn3, 0);

    clock_add_to_group(clock_i2c0, 0);
    clock_add_to_group(clock_i2c1, 0);
    clock_add_to_group(clock_i2c2, 0);
    clock_add_to_group(clock_i2c3, 0);

    clock_add_to_group(clock_adc0, 0);
    clock_add_to_group(clock_adc1, 0);
    clock_add_to_group(clock_adc2, 0);
    clock_add_to_group(clock_adc3, 0);

    /* Connect Group0 to CPU0 */
    clock_connect_group_to_cpu(0, 0);

    /* Add the CPU1 clock to Group1 */
    clock_add_to_group(clock_cpu1, 0);
    clock_add_to_group(clock_mchtmr1, 1);

    /* Connect Group1 to CPU1 */
    clock_connect_group_to_cpu(1, 1);

    /* Bump up DCDC voltage to 1200mv */
    pcfg_dcdc_set_voltage(HPM_PCFG, 1200);

    /* Configure mchtmr to 24MHz */
    clock_set_source_divider(clock_mchtmr0, clk_src_osc24m, 1);
    clock_set_source_divider(clock_mchtmr1, clk_src_osc24m, 1);

    clock_update_core_clock();
}

uint32_t board_init_uart_clock(UART_Type *ptr)
{
    uint32_t freq = 0U;
    if (ptr == HPM_UART0) {
        clock_set_source_divider(clock_uart0, clk_src_osc24m, 1);
        clock_add_to_group(clock_uart0, 0);
        freq = clock_get_frequency(clock_uart0);
    } else if (ptr == HPM_UART1) {
        clock_set_source_divider(clock_uart1, clk_src_pll1_clk0, 10);
        clock_add_to_group(clock_uart1, 0);
        freq = clock_get_frequency(clock_uart1);
    } else if (ptr == HPM_UART2) {
        clock_set_source_divider(clock_uart2, clk_src_pll1_clk0, 10);
        clock_add_to_group(clock_uart2, 0);
        freq = clock_get_frequency(clock_uart2);
    } else if (ptr == HPM_UART6) {
        clock_set_source_divider(clock_uart6, clk_src_pll1_clk0, 10);
        clock_add_to_group(clock_uart6, 0);
        freq = clock_get_frequency(clock_uart6);
    } else {
        /* Not supported */
    }
    return freq;
}

void board_tsw_phy_set(uint8_t index, bool flag)
{
    switch (index)
    {
        case 0:
            gpio_write_pin(BOARD_TSN_P1_RESET_CTRL, BOARD_TSN_P1_RESET_INDEX, BOARD_TSN_P1_RESET_PIN, flag);
            break;
        case 1:
            gpio_write_pin(BOARD_TSN_P2_RESET_CTRL, BOARD_TSN_P2_RESET_INDEX, BOARD_TSN_P2_RESET_PIN, flag);
            break;
        case 2:
            gpio_write_pin(BOARD_TSN_P3_RESET_CTRL, BOARD_TSN_P3_RESET_INDEX, BOARD_TSN_P3_RESET_PIN, flag);
            break;   
        default:
            break;
    }
}

void board_init_ethercat(ESC_Type *ptr)
{
    (void)ptr;
    init_esc_pins();
    /* keep ECAT PHY reset */
    gpio_set_pin_output_with_initial(BOARD_ECAT_PHY0_RESET_GPIO, BOARD_ECAT_PHY0_RESET_GPIO_PORT_INDEX, BOARD_ECAT_PHY0_RESET_PIN_INDEX, BOARD_ECAT_PHY_RESET_LEVEL);
    gpio_set_pin_output_with_initial(BOARD_ECAT_PHY1_RESET_GPIO, BOARD_ECAT_PHY1_RESET_GPIO_PORT_INDEX, BOARD_ECAT_PHY1_RESET_PIN_INDEX, BOARD_ECAT_PHY_RESET_LEVEL);
    gpio_set_pin_output_with_initial(BOARD_ECAT_PHY2_RESET_GPIO, BOARD_ECAT_PHY2_RESET_GPIO_PORT_INDEX, BOARD_ECAT_PHY2_RESET_PIN_INDEX, BOARD_ECAT_PHY_RESET_LEVEL);
}

/* input and output pin for ethercat io */
void board_init_switch_led(void)
{
    init_esc_in_out_pin();

    gpio_set_pin_input(BOARD_ECAT_IN1_GPIO, BOARD_ECAT_IN1_GPIO_PORT_INDEX, BOARD_ECAT_IN1_GPIO_PIN_INDEX);
    gpio_set_pin_input(BOARD_ECAT_IN2_GPIO, BOARD_ECAT_IN2_GPIO_PORT_INDEX, BOARD_ECAT_IN2_GPIO_PIN_INDEX);
    gpio_set_pin_input(BOARD_ECAT_IN3_GPIO, BOARD_ECAT_IN3_GPIO_PORT_INDEX, BOARD_ECAT_IN3_GPIO_PIN_INDEX);
    gpio_set_pin_input(BOARD_ECAT_IN4_GPIO, BOARD_ECAT_IN4_GPIO_PORT_INDEX, BOARD_ECAT_IN4_GPIO_PIN_INDEX);
    gpio_set_pin_input(BOARD_ECAT_IN5_GPIO, BOARD_ECAT_IN5_GPIO_PORT_INDEX, BOARD_ECAT_IN5_GPIO_PIN_INDEX);
    gpio_set_pin_input(BOARD_ECAT_IN6_GPIO, BOARD_ECAT_IN6_GPIO_PORT_INDEX, BOARD_ECAT_IN6_GPIO_PIN_INDEX);
    gpio_set_pin_input(BOARD_ECAT_IN7_GPIO, BOARD_ECAT_IN7_GPIO_PORT_INDEX, BOARD_ECAT_IN7_GPIO_PIN_INDEX);
    gpio_set_pin_input(BOARD_ECAT_IN8_GPIO, BOARD_ECAT_IN8_GPIO_PORT_INDEX, BOARD_ECAT_IN8_GPIO_PIN_INDEX);

    gpio_set_pin_output_with_initial(BOARD_ECAT_OUT1_GPIO, BOARD_ECAT_OUT1_GPIO_PORT_INDEX, BOARD_ECAT_OUT1_GPIO_PIN_INDEX, 0);
    gpio_set_pin_output_with_initial(BOARD_ECAT_OUT2_GPIO, BOARD_ECAT_OUT2_GPIO_PORT_INDEX, BOARD_ECAT_OUT2_GPIO_PIN_INDEX, 0);
    gpio_set_pin_output_with_initial(BOARD_ECAT_OUT3_GPIO, BOARD_ECAT_OUT3_GPIO_PORT_INDEX, BOARD_ECAT_OUT3_GPIO_PIN_INDEX, 0);
    gpio_set_pin_output_with_initial(BOARD_ECAT_OUT4_GPIO, BOARD_ECAT_OUT4_GPIO_PORT_INDEX, BOARD_ECAT_OUT4_GPIO_PIN_INDEX, 0);
    gpio_set_pin_output_with_initial(BOARD_ECAT_OUT5_GPIO, BOARD_ECAT_OUT5_GPIO_PORT_INDEX, BOARD_ECAT_OUT5_GPIO_PIN_INDEX, 0);
    gpio_set_pin_output_with_initial(BOARD_ECAT_OUT6_GPIO, BOARD_ECAT_OUT6_GPIO_PORT_INDEX, BOARD_ECAT_OUT6_GPIO_PIN_INDEX, 0);
    gpio_set_pin_output_with_initial(BOARD_ECAT_OUT7_GPIO, BOARD_ECAT_OUT7_GPIO_PORT_INDEX, BOARD_ECAT_OUT7_GPIO_PIN_INDEX, 0);
    gpio_set_pin_output_with_initial(BOARD_ECAT_OUT8_GPIO, BOARD_ECAT_OUT8_GPIO_PORT_INDEX, BOARD_ECAT_OUT8_GPIO_PIN_INDEX, 0);
}

void board_init_tsw(void)
{

    init_tsw_pins();

    /* PORT1 2 3 RESET*/
    gpio_set_pin_output_with_initial(BOARD_TSN_P1_RESET_CTRL, BOARD_TSN_P1_RESET_INDEX, BOARD_TSN_P1_RESET_PIN, 0);
    gpio_set_pin_output_with_initial(BOARD_TSN_P2_RESET_CTRL, BOARD_TSN_P2_RESET_INDEX, BOARD_TSN_P2_RESET_PIN, 0);
    gpio_set_pin_output_with_initial(BOARD_TSN_P3_RESET_CTRL, BOARD_TSN_P3_RESET_INDEX, BOARD_TSN_P3_RESET_PIN, 0);

    /* PORT1 2 3 INT */
    gpio_set_pin_input(BOARD_TSN_P1_INT_CTRL, BOARD_TSN_P1_INT_INDEX, BOARD_TSN_P1_INT_PIN);
    gpio_set_pin_input(BOARD_TSN_P2_INT_CTRL, BOARD_TSN_P2_INT_INDEX, BOARD_TSN_P2_INT_PIN);
    gpio_set_pin_input(BOARD_TSN_P3_INT_CTRL, BOARD_TSN_P3_INT_INDEX, BOARD_TSN_P3_INT_PIN);
}
